## boot/Kconfig
```kconfig
menu "MCU SBL core"

if !SOC_LPC55S69_SERIES
    config ROM_VERIFY_SBL
        bool "Enable ROM to verify sbl"
        default n
        help
            If enabled, the sbl image can be verified by ROM.
endif

config CONFIG_MCUBOOT_MAX_IMG_SECTORS
    int "Maximum number of flash sectors per image"
    default 400
    help
        Default maximum number of flash sectors per image slot.

config SINGLE_IMAGE
    bool "Enable single image function"
    default n
    help
        If enabled, there is only one image slot.

menu "MCU SBL Flash Map"

config BOOT_FLASH_BASE
    hex "Flash base address"
    default 0x60000000
    help
        The base address of the flash.

config BOOT_FLASH_HEADER
    hex "Metadata header address"
    default 0x60010000
    help
        The metadata header address.

config BOOT_FLASH_ACT_APP
    hex "Active APP start address"
    default 0x60100000
    help
        The active application start address.

config BOOT_FLASH_CAND_APP
    hex "Candidate APP start address"
    default 0x60200000
    help
        The candidate application start address.

config BOOT_FLASH_CUSTOMER
    hex "Customer space start address"
    default 0x603f0000
    help
        The customer space start address.
endmenu

endmenu
```

## component/Kconfig
```kconfig
menu "MCU SBL Component"

source "$SBL_DIR/component/flashiap/Kconfig"

source "$SBL_DIR/component/secure/Kconfig"

source "$SBL_DIR/component/serial_manager/Kconfig"

source "$SBL_DIR/component/mcu_isp/Kconfig"

endmenu
```

## component/flashiap/Kconfig
```kconfig
menu "Flash IAP"

config COMPONENT_FLASHIAP
    bool "Enable flash in application programming"
    default y
    help
        Enable flash in application programming.

if COMPONENT_FLASHIAP

    config COMPONENT_FLASHIAP_ROM
        bool "using ROM flash interface"
        default y
        help
            Using ROM flash interface in default.

    menu "Flash device parameters"
        config COMPONENT_FLASHIAP_SIZE
            int "flash size"
            default 8388608

    endmenu

endif

endmenu
```

## component/mcu_isp/Kconfig
```kconfig
menu "mcu isp support"

config COMPONENT_MCU_ISP
    bool "Enable mcu isp support"
    default n
    help
        Enable mcu isp support.

    if COMPONENT_MCU_ISP
        config ISP_TIMEOUT
            int "Set isp timeout by seconds"
            default 5
            help
                Set isp timeout to wait for USB/UART connection.
    endif

endmenu
```

## component/secure/Kconfig
```kconfig
menu "secure"
    config COMPONENT_MCUBOOT_SECURE
        bool "Select image security function"
        default y

        if COMPONENT_MCUBOOT_SECURE
		config CONFIG_BOOT_SIGNATURE
			bool "Signature function"
			default n
			help
				Use signature function.
			if CONFIG_BOOT_SIGNATURE
				choice
					prompt "Selected signing method"
		
					config CONFIG_BOOT_SIGNATURE_TYPE_RSA
						bool "Select signature type RSA"
						help
							Set signature type as RSA.

					config CONFIG_BOOT_SIGNATURE_TYPE_ROM
						bool "Select signature type ROM use"
						help
							Set signature type ROM use.
                        depends on (SOC_IMXRTYYYY_SERIES || SOC_LPC55S69_SERIES)

					config CONFIG_BOOT_SIGNATURE_TYPE_ECDSA_P256
						bool "Select signature type ECDSA_P256"
						help
							Set signature type as ECDSAP256.
				endchoice
				
				if SOC_IMXRTYYYY_SERIES
					config CONFIG_HAB_CLOSE
						bool "Verify HAB close"
						default n
						help
                            Check if HAB is in closed state. If not, verification would be failed.
                    depends on CONFIG_BOOT_SIGNATURE_TYPE_ROM
                endif
				
				if CONFIG_BOOT_SIGNATURE_TYPE_RSA
					config CONFIG_BOOT_SIGNATURE_TYPE_RSA_LEN
					int "rsa length"
					default 2048
				endif
			endif

    	    if SOC_IMXRTYYYY_SERIES
                config CONFIG_BOOT_ENCRYPTED_XIP
                    bool "Encrypted XIP function"
                    default n
    		        help
        		        Use encrypted application image.
            endif
        endif

        config COMPONENT_MBEDTLS
            bool "enable mbedtls"
            default y
            help
                enable mbedtls.
		
    	if COMPONENT_MBEDTLS
    	    config SBL_MBEDTLS_CONFIG_FILE
    	        string "Set mbedtls config file"
    	        default "ksdk_mbedtls_config.h"
    	        help
    	            Set the specific mbedtls config file.
    	endif
endmenu
```

## component/serial_manager/Kconfig
```kconfig
menu "Serial Manager"

config COMPONENT_SERIAL_MANAGER
    bool "Enable serial manager"
    default y
    help
        Enable serial manager

if COMPONENT_SERIAL_MANAGER

    choice
        prompt "Select the serial port"
        default COMPONENT_SERIAL_MANAGER_LPUART

        config COMPONENT_SERIAL_MANAGER_LPUART
            bool "lpuart"

        config COMPONENT_SERIAL_MANAGER_USB
            bool "serial over USB"

        config COMPONENT_SERIAL_MANAGER_SWO
            bool "SWO"

    endchoice

    config SERIAL_PORT_TYPE_UART
	int
	default 1 if COMPONENT_SERIAL_MANAGER_LPUART
    config SERIAL_PORT_TYPE_USBCDC
	int
	default 1 if COMPONENT_SERIAL_MANAGER_USB
    config SERIAL_PORT_TYPE_SWO
	int
	default 1 if COMPONENT_SERIAL_MANAGER_SWO
endif

endmenu
```

## target/evkmimxrt1060/Kconfig
```kconfig
mainmenu "MCU-SBL RT1060 Configuration"

config SBL_DIR
    string
    option env="SBL_ROOT"
    default "../../"

config SOC_IMXRT1060_SERIES
    bool
    select ARCH_ARM_CORTEX_M7
    select ARCH_ARM_CORTEX_FPU
	select SOC_IMXRTYYYY_SERIES
	select SOC_REMAP_ENABLE

config ARCH_ARM_CORTEX_M7
    bool

config ARCH_ARM_CORTEX_FPU
    bool

config SOC_IMXRTYYYY_SERIES
    bool

config SOC_REMAP_ENABLE
    bool

config COMPONENT_MCU_ISP
    bool
    select SOC_GPIO

source "$SBL_DIR/Kconfig"
menu "Platform Drivers Config"

config BOARD_FLASH_SUPPORT
    bool "Board flash support"
    default y
    help
        Select the flash board used.

if BOARD_FLASH_SUPPORT
    choice
        prompt "Select the flash"
        default ISSI_IS25WPxxxA

        config ISSI_AT25SFxxxA
            bool "ISSI_AT25SFxxxA Flash"
            select SOC_FLEXSPI
            select SOC_FLEXSPI_1

        config ISSI_IS25LPxxxA
            bool "ISSI_IS25LPxxxA Flash"
            select SOC_FLEXSPI
            select SOC_FLEXSPI_1
			
        config Cypress_S26KSxxxS
            bool "Cypress_S26KSxxxS Flash"
            select SOC_FLEXSPI
            select SOC_FLEXSPI_1

        config ISSI_IS25WPxxxA
            bool "ISSI_IS25WPxxxA Flash"
            select SOC_FLEXSPI
            select SOC_FLEXSPI_1

        config WINBOND_W25QxxxJV
            bool "WINBOND_W25QxxxJV Flash"
            select SOC_FLEXSPI
            select SOC_FLEXSPI_1

        config Macronix_MX25UM51345G
            bool "Macronix_MX25UM51345G Flash"
            select SOC_FLEXSPI
            select SOC_FLEXSPI_1

        config Macronix_MX25UM51345G_2nd
            bool "Macronix_MX25UM51345G_2nd Flash"
            select SOC_FLEXSPI
            select SOC_FLEXSPI_1

    endchoice
endif

config SOC_MIMXRT1062DVL6A
    bool
    select SOC_IMXRT1060_SERIES
    default y

menu "On-chip Peripheral Drivers"

    config SOC_GPIO
        bool "Enable GPIO"
        default y

    menuconfig SOC_LPUART
        bool "Enable UART"
        default y
        if SOC_LPUART
            config SOC_LPUART_1
                bool "Enable LPUART1"
                default y
            config SOC_LPUART_2
                bool "Enable LPUART2"
                default n
        endif

    config SOC_FLEXSPI
        bool "Enable FlexSPI"
        default n
        if SOC_FLEXSPI
            config SOC_FLEXSPI_1
                bool "Enable FlexSPI1"
                default y
            config SOC_FLEXSPI_2
                bool "Enable FlexSPI2"
                default n
	endif
endmenu

menu "Onboard Peripheral Drivers"

    config BOARD_SDRAM
        bool "Enable SDRAM"
        default n

endmenu

menu "Board extended module Drivers"

endmenu

endmenu
```

## target/evkmimxrt500/Kconfig
```kconfig
mainmenu "MCU-SBL RT500 Configuration"

config SBL_DIR
    string
    option env="SBL_ROOT"
    default "../../"

config SOC_IMXRT500_SERIES
    bool
    select ARCH_ARM_CORTEX_M33
    select ARCH_ARM_CORTEX_FPU
	select SOC_IMXRTXXX_SERIES
    select SOC_REMAP_ENABLE

config ARCH_ARM_CORTEX_M33
    bool

config ARCH_ARM_CORTEX_FPU
    bool

config SOC_IMXRTXXX_SERIES
    bool

config SOC_REMAP_ENABLE
    bool

config COMPONENT_MCU_ISP
    bool
    select SOC_INPUTMUX
    select SOC_PINT

source "$SBL_DIR/Kconfig"
menu "Platform Drivers Config"

config BOARD_FLASH_SUPPORT
    bool "Board flash support"
    default y
    help
        Select the flash board used.

if BOARD_FLASH_SUPPORT
    choice
        prompt "Select the flash"
        default Macronix_MX25UM51345G

        config ISSI_AT25SFxxxA
            bool "ISSI_AT25SFxxxA Flash"
            select SOC_FLEXSPI
            select SOC_FLEXSPI_0

        config ISSI_IS25LPxxxA
            bool "ISSI_IS25LPxxxA Flash"
            select SOC_FLEXSPI
            select SOC_FLEXSPI_0
			
        config Cypress_S26KSxxxS
            bool "Cypress_S26KSxxxS Flash"
            select SOC_FLEXSPI
            select SOC_FLEXSPI_0

        config ISSI_IS25WPxxxA
            bool "ISSI_IS25WPxxxA Flash"
            select SOC_FLEXSPI
            select SOC_FLEXSPI_0

        config WINBOND_W25QxxxJV
            bool "WINBOND_W25QxxxJV Flash"
            select SOC_FLEXSPI
            select SOC_FLEXSPI_0

        config Macronix_MX25UM51345G
            bool "Macronix_MX25UM51345G Flash"
            select SOC_FLEXSPI
            select SOC_FLEXSPI_0

        config Macronix_MX25UM51345G_2nd
            bool "Macronix_MX25UM51345G_2nd Flash"
            select SOC_FLEXSPI
            select SOC_FLEXSPI_0

    endchoice
endif

config SOC_MIMXRT595S_M33
    bool
    select SOC_IMXRT500_SERIES
    default y

menu "On-chip Peripheral Drivers"

    config SOC_GPIO
        bool "Enable GPIO"
        default n

    menuconfig SOC_UART
        bool "Enable UART"
        default y
        if SOC_LPUART
            config SOC_UART_1
                bool "Enable UART1"
                default y
            config SOC_UART_2
                bool "Enable UART2"
                default n
        endif

    config SOC_FLEXSPI
        bool "Enable FlexSPI"
        default n
        if SOC_FLEXSPI
            config SOC_FLEXSPI_0
                bool "Enable FlexSPI0"
                default y
            config SOC_FLEXSPI_1
                bool "Enable FlexSPI1"
                default y

    config SOC_INPUTMUX
        bool "Enable INPUTMUX"
        default y

    config SOC_PINT
        bool "Enable PINT"
        default y
	endif
endmenu

menu "Onboard Peripheral Drivers"

endmenu

menu "Board extended module Drivers"

endmenu

endmenu
```

## target/lpc55s69/Kconfig
```kconfig
mainmenu "MCU-SBL LPC55S69 Configuration"

config SBL_DIR
    string
    option env="SBL_ROOT"
    default "../../"

config SOC_LPC55S69_SERIES
    bool
    select ARCH_ARM_CORTEX_M33
    select ARCH_ARM_CORTEX_FPU
	select SOC_LPC_SERIES
	
config ARCH_ARM_CORTEX_M33
    bool

config ARCH_ARM_CORTEX_FPU
    bool

config SOC_LPC_SERIES
    bool

config COMPONENT_MCU_ISP
    bool
    select SOC_GPIO
    select CONFIG_SOC_INPUTMUX
    select CONFIG_SOC_PINT
    select CONFIG_SOC_GINT

source "$SBL_DIR/Kconfig"
menu "Platform Drivers Config"

config BOARD_FLASH_SUPPORT
    bool "Board flash support"
    default y
    help
        Select the flash board used.

if BOARD_FLASH_SUPPORT
    choice
        prompt "Select the flash"
        default INTERNAL_FLASH

    endchoice
endif

config SOC_CPU_LPC55S69JBD100_cm33_core0
    bool
    select SOC_LPC55S69_SERIES
    default y

menu "On-chip Peripheral Drivers"

    config SOC_GPIO
        bool "Enable GPIO"
        default n

    menuconfig SOC_LPUART
        bool "Enable UART"
        default y
        if SOC_LPUART
            config SOC_LPUART_1
                bool "Enable USART1"
                default y
            config SOC_LPUART_2
                bool "Enable USART2"
                default n
        endif

    config SOC_INPUTMUX
        bool "Enable INPUTMUX"
        default y

    config SOC_PINT
        bool "Enable PINT"
        default y

    config SOC_GINT
        bool "Enable GINT"
        default y

endmenu


menu "Board extended module Drivers"

endmenu

endmenu
```
